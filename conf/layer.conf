## scripts/lib/wic/canned-wks/dhsom-uboot-bootpart.wks
```
# short-description: Create SD card image with a boot partition
# long-description:
# Create an image that can be written onto a SD card using dd for use
# with i.MX SoC family
# It uses u-boot
#
# The disk layout used is:
#  - --------- -------------- --------------
# | | u-boot  |     boot     |    rootfs   |
#  - --------- -------------- --------------
# ^ ^         ^              ^
# | |         |              |
# 0 1kiB    4MiB          16MiB + rootfs + IMAGE_EXTRA_SPACE (default 10MiB)
#

part u-boot --source rawcopy --sourceparams="file=u-boot-with-spl.imx" --ondisk mmcblk --no-table --align 1
part /boot --source bootimg-partition --ondisk mmcblk1 --fstype=vfat --label boot --active --align 4096 --size 16
part / --source rootfs --ondisk mmcblk1 --fstype=ext3 --label root --align 4096 --size 100

bootloader --ptable gpt
```

## scripts/lib/wic/canned-wks/sdimage-imx8mp.wks
```
# short-description: Create DH IMX8MP SD card image with a boot partition
# long-description: Creates a partitioned SD card image. Boot files
# are located in the first ext4 partition.

part --source rawcopy --sourceparams="file=flash.bin" --ondisk mmcblk --no-table --align 32 --size 8192k
part / --source rootfs --ondisk mmcblk0 --fstype=ext4 --label root --active --align 4096
```
