## conf/layer.conf
```bitbake
# We have a conf and classes directory, add to BBPATH
BBPATH .= ":${LAYERDIR}"

# We have a packages directory, add to BBFILES
BBFILES += "${LAYERDIR}/recipes-*/*/*.bb"
BBFILES += "${LAYERDIR}/recipes-*/*/*.bbappend"

BBFILE_COLLECTIONS += "dhsomimxbsp"
BBFILE_PATTERN_dhsomimxbsp = "^${LAYERDIR}/"
BBFILE_PRIORITY_dhsomimxbsp = "5"

LAYERDEPENDS_dhsomimxbsp = "core mainlinecommon-layer"
LAYERSERIES_COMPAT_dhsomimxbsp = "kirkstone scarthgap"

BBFILES_DYNAMIC += " \
	freescale-layer:${LAYERDIR}/dynamic-layers/freescale-layer/*/*/*.bb \
	freescale-layer:${LAYERDIR}/dynamic-layers/freescale-layer/*/*/*.bbappend \
	"
```

## conf/machine/dh-imx6-dhcom-drc02.conf
```bitbake
#@TYPE: Machine
#@NAME: DH IMX6 DHCOM SoM on DRC02 carrier board
#@SOC:  NXP IMX6
#@DESCRIPTION: Machine configuration for DH IMX6 DHCOM SoM on DRC02 carrier board

require conf/machine/include/dh-imx6qdl-common.inc

# U-Boot bootloader
UBOOT_MACHINE = "dh_imx6_defconfig"

# Linux kernel
KERNEL_DEVICETREE ?= " \
	${KERNEL_DEVICETREE_PATH_PREFIX}imx6s-dhcom-drc02.dtb \
	"
```

## conf/machine/dh-imx6-dhcom-pdk2.conf
```bitbake
#@TYPE: Machine
#@NAME: DH IMX6 DHCOM SoM on PDK2 carrier board
#@SOC:  NXP IMX6
#@DESCRIPTION: Machine configuration for DH IMX6 DHCOM SoM on PDK2 carrier board

require conf/machine/include/dh-imx6qdl-common.inc

# U-Boot bootloader
UBOOT_MACHINE = "dh_imx6_defconfig"

# Linux kernel
KERNEL_DEVICETREE ?= " \
	${KERNEL_DEVICETREE_PATH_PREFIX}imx6q-dhcom-pdk2.dtb \
	${KERNEL_DEVICETREE_PATH_PREFIX}imx6qdl-dhcom-pdk2-overlay-497-200-x12.dtbo \
	${KERNEL_DEVICETREE_PATH_PREFIX}imx6qdl-dhcom-pdk2-overlay-531-100-x21.dtbo \
	${KERNEL_DEVICETREE_PATH_PREFIX}imx6qdl-dhcom-pdk2-overlay-531-100-x22.dtbo \
	${KERNEL_DEVICETREE_PATH_PREFIX}imx6qdl-dhcom-pdk2-overlay-505-200-x12-ch101olhlwh.dtbo \
	${KERNEL_DEVICETREE_PATH_PREFIX}imx6qdl-dhcom-pdk2-overlay-560-200-x12.dtbo \
	"
```

## conf/machine/dh-imx6-dhcom-picoitx.conf
```bitbake
#@TYPE: Machine
#@NAME: DH IMX6 DHCOM SoM on PicoITX carrier board
#@SOC:  NXP IMX6
#@DESCRIPTION: Machine configuration for DH IMX6 DHCOM SoM on PicoITX carrier board

require conf/machine/include/dh-imx6-common.inc

# U-Boot bootloader
UBOOT_MACHINE = "dh_imx6_defconfig"

# Linux kernel
KERNEL_DEVICETREE ?= " \
	imx6dl-dhcom-picoitx.dtb \
	imx6qdl-dhcom-picoitx-overlay-626-100-x2-ch101olhlwh.dtbo \
	"
```

## conf/machine/dh-imx6ull-dhcom-pdk2.conf
```bitbake
#@TYPE: Machine
#@NAME: DH IMX6ULL DHCOM SoM on PDK2 carrier board
#@SOC:  NXP IMX6ULL
#@DESCRIPTION: Machine configuration for DH IMX6ULL DHCOM SoM on PDK2 carrier board

require conf/machine/include/dh-imx6ull-common.inc

# U-Boot bootloader
UBOOT_MACHINE = "dh_imx6ull_emmc_defconfig"

# Linux kernel
KERNEL_DEVICETREE ?= " \
	imx6ull-dhcom-pdk2.dtb \
	"

MACHINE_ESSENTIAL_EXTRA_RDEPENDS += " \
	cypress-firmware-bcm43xx-fmac-fw-bcm43430-1dx-sdio \
	cypress-firmware-bcm43xx-fmac-nvram-bcm43430-1dx-sdio \
	cypress-firmware-bcm43xx-bt-patch-bcm4343a1 \
	"
```

## conf/machine/dh-imx6ull-dhcom-picoitx.conf
```bitbake
#@TYPE: Machine
#@NAME: DH IMX6ULL DHCOM SoM on picoITX carrier board
#@SOC:  NXP IMX6ULL
#@DESCRIPTION: Machine configuration for DH IMX6ULL DHCOM SoM on picoITX carrier board

require conf/machine/include/dh-imx6ull-common.inc

# U-Boot bootloader
UBOOT_MACHINE = "dh_imx6ull_emmc_defconfig"

# Linux kernel
KERNEL_DEVICETREE ?= " \
	imx6ull-dhcom-picoitx.dtb \
	"
```

## conf/machine/dh-imx8mp-dhcom-drc02.conf
```bitbake
#@TYPE: Machine
#@NAME: DH IMX8MP DHCOM SoM on DRC02 carrier board
#@SOC:  NXP IMX8MP
#@DESCRIPTION: Machine configuration for DH IMX8MP DHCOM SoM on DRC02 carrier board

require conf/machine/include/dh-imx8mp-common.inc

# U-Boot bootloader
UBOOT_MACHINE = "imx8mp_dhcom_drc02_defconfig"

# Linux kernel
KERNEL_DEVICETREE = " \
	freescale/imx8mp-dhcom-drc02.dtb \
	"

# Downstream BSP specific configuration
UBOOT_DTB_NAME = "imx8mp-dhcom-drc02.dtb"
```

## conf/machine/dh-imx8mp-dhcom-pdk2.conf
```bitbake
#@TYPE: Machine
#@NAME: DH IMX8MP DHCOM SoM on PDK2 carrier board
#@SOC:  NXP IMX8MP
#@DESCRIPTION: Machine configuration for DH IMX8MP DHCOM SoM on PDK2 carrier board

require conf/machine/include/dh-imx8mp-common.inc

# U-Boot bootloader
UBOOT_MACHINE = "imx8mp_dhcom_pdk2_defconfig"

# Linux kernel
KERNEL_DEVICETREE = " \
	freescale/imx8mp-dhcom-pdk2.dtb \
	freescale/imx8mp-dhcom-som-overlay-eth1xfast.dtbo \
	freescale/imx8mp-dhcom-som-overlay-eth2xfast.dtbo \
	freescale/imx8mp-dhcom-pdk-overlay-eth2xfast.dtbo \
	freescale/imx8mp-dhcom-pdk2-overlay-531-100-x21.dtbo \
	freescale/imx8mp-dhcom-pdk2-overlay-531-100-x22.dtbo \
	freescale/imx8mp-dhcom-pdk2-overlay-505-200-x12-ch101olhlwh.dtbo \
	freescale/imx8mp-dhcom-pdk2-overlay-560-300-x12.dtbo \
	"

# Ship WiFi/BT firmware
MACHINE_ESSENTIAL_EXTRA_RDEPENDS += " \
        cypress-firmware-bcm43xx-bt-patch-bcm4373a0-2ae \
        cypress-firmware-bcm43xx-fmac-fw-bcm4373-2ae-sdio \
        cypress-firmware-bcm43xx-fmac-nvram-bcm4373-2ae-sdio \
        "

# Downstream BSP specific configuration
UBOOT_DTB_NAME = "imx8mp-dhcom-pdk2.dtb"
```

## conf/machine/dh-imx8mp-dhcom-pdk3.conf
```bitbake
#@TYPE: Machine
#@NAME: DH IMX8MP DHCOM SoM on PDK3 carrier board
#@SOC:  NXP IMX8MP
#@DESCRIPTION: Machine configuration for DH IMX8MP DHCOM SoM on PDK3 carrier board

require conf/machine/include/dh-imx8mp-common.inc

# U-Boot bootloader
UBOOT_MACHINE = "imx8mp_dhcom_pdk3_defconfig"

# Linux kernel
KERNEL_DEVICETREE = " \
	freescale/imx8mp-dhcom-pdk3.dtb \
	freescale/imx8mp-dhcom-som-overlay-eth1xfast.dtbo \
	freescale/imx8mp-dhcom-som-overlay-eth2xfast.dtbo \
	freescale/imx8mp-dhcom-pdk-overlay-eth2xfast.dtbo \
	freescale/imx8mp-dhcom-pdk3-overlay-531-100-x40.dtbo \
	freescale/imx8mp-dhcom-pdk3-overlay-531-100-x41.dtbo \
	freescale/imx8mp-dhcom-pdk3-overlay-505-200-x36-ch101olhlwh.dtbo \
	freescale/imx8mp-dhcom-pdk3-overlay-560-300-x36.dtbo \
	freescale/imx8mp-dhcom-pdk3-overlay-732-100-x36.dtbo \
	freescale/imx8mp-dhcom-pdk3-overlay-ea-murata-2ae-x20.dtbo \
	freescale/imx8mp-dhcom-pdk3-overlay-nxp-spf-29853-c1-ov5640-x29.dtbo \
	freescale/imx8mp-dhcom-pdk3-overlay-nxp-spf-29853-c1-ov5640-x31.dtbo \
	"

# Linux 6.18.y port dropped rev.100 SoM and PDK3 support
KERNEL_DEVICETREE += "\
	${@'' if bb.utils.vercmp_string_op(d.getVar('PREFERRED_VERSION_linux-stable'), '6.18', '>=') else \
	' \
	freescale/imx8mp-dhcom-som-overlay-rev100.dtbo \
	freescale/imx8mp-dhcom-pdk3-overlay-rev100.dtbo \
	freescale/imx8mp-dhcom-pdk3-rev100-overlay.dtbo \
	freescale/imx8mp-dhcom-pdk3-rev100-overlay-nxp-spf-29853-c1-ov5640-x29.dtbo \
	freescale/imx8mp-dhcom-pdk3-rev100-overlay-nxp-spf-29853-c1-ov5640-x31.dtbo \
	'}"

# Ship WiFi/BT firmware
MACHINE_ESSENTIAL_EXTRA_RDEPENDS += " \
        cypress-firmware-bcm43xx-bt-patch-bcm4373a0-2ae \
        cypress-firmware-bcm43xx-fmac-nvram-bcm4373-2ae-sdio \
        ifx-firmware-bcm43xx-fmac-fw-bcm4373-sdio \
        "
```

## conf/machine/dh-imx8mp-dhcom-picoitx.conf
```bitbake
#@TYPE: Machine
#@NAME: DH IMX8MP DHCOM SoM on PicoITX carrier board
#@SOC:  NXP IMX8MP
#@DESCRIPTION: Machine configuration for DH IMX8MP DHCOM SoM on PicoITX carrier board

require conf/machine/include/dh-imx8mp-common.inc

# U-Boot bootloader
UBOOT_MACHINE = "imx8mp_dhcom_picoitx_defconfig"

# Linux kernel
KERNEL_DEVICETREE = " \
	freescale/imx8mp-dhcom-picoitx.dtb \
	freescale/imx8mp-dhcom-picoitx-overlay-626-100-x2-ch101olhlwh.dtbo \
	"
```

## conf/machine/include/dh-imx-common.inc
```bitbake
MACHINEOVERRIDES =. "dh-dhsom:dh-imx-dhsom:"

MACHINE_FEATURES ?= "apm alsa ext2 keyboard screen serial touchscreen usbgadget usbhost"

# U-Boot bootloader
UBOOT_ENV = "boot"
UBOOT_ENV_SUFFIX = "scr"

PREFERRED_PROVIDER_virtual/bootloader ?= "u-boot-mainline"
PREFERRED_PROVIDER_u-boot ?= "u-boot-mainline"
PREFERRED_PROVIDER_u-boot-native ?= "u-boot-mainline"
PREFERRED_PROVIDER_u-boot-fw-utils ?= "u-boot-mainline-fw-utils"
PREFERRED_PROVIDER_u-boot-fw-utils-native ?= "u-boot-mainline-fw-utils-native"
PREFERRED_PROVIDER_u-boot-mkimage-native ?= "u-boot-mainline-tools-native"
PREFERRED_PROVIDER_u-boot-tools ?= "u-boot-mainline-tools"
PREFERRED_PROVIDER_u-boot-tools-native ?= "u-boot-mainline-tools-native"
PREFERRED_VERSION_u-boot-mainline ?= "2025.07%"
PREFERRED_VERSION_u-boot-mainline-native ?= "2025.07%"
PREFERRED_VERSION_u-boot-mainline-fw-utils ?= "2025.07%"
PREFERRED_VERSION_u-boot-mainline-fw-utils-native ?= "2025.07%"
PREFERRED_VERSION_u-boot-mainline-tools ?= "2025.07%"
PREFERRED_VERSION_u-boot-mainline-tools-native ?= "2025.07%"

# Linux kernel
KERNEL_IMAGETYPE = "fitImage"
KERNEL_CLASSES += " kernel-fitimage "

# WPE (from meta-webkit)
PREFERRED_RPROVIDER_virtual/wpebackend ?= "wpebackend-fdo"

# Ship kernel modules
MACHINE_ESSENTIAL_EXTRA_RDEPENDS += " \
	kernel-modules kernel-devicetree \
	u-boot-default-env \
	"

# List of images to be built
IMAGE_FSTYPES ?= "tar.zst wic.zst wic.gz wic.bmap"
INITRAMFS_FSTYPES ?= "cpio.zst"

DH_UBOOT_RECIPE ?= "u-boot-mainline"
EXTRA_IMAGEDEPENDS += "${DH_UBOOT_RECIPE}"
IMAGE_BOOT_FILES ?= "${KERNEL_IMAGETYPE}"
IMAGE_INSTALL:append = " kernel-devicetree kernel-image-fitimage ${DH_UBOOT_RECIPE} "
do_image_wic[depends] += "mtools-native:do_populate_sysroot dosfstools-native:do_populate_sysroot ${DH_UBOOT_RECIPE}:do_deploy"

# Add any optional config files that might be present e.g. in other layers
include conf/machine/${MACHINE}-extra.conf
```

## conf/machine/include/dh-imx-mainline.inc
```bitbake
# Mainline BSP overrides

MACHINE_FEATURES += " mainline"

# Mesa
PREFERRED_PROVIDER_virtual/egl ?= "mesa-mainline"
PREFERRED_PROVIDER_virtual/libgl ?= "mesa-mainline"
PREFERRED_PROVIDER_virtual/libgles1 ?= "mesa-mainline"
PREFERRED_PROVIDER_virtual/libgles2 ?= "mesa-mainline"
PREFERRED_PROVIDER_virtual/libgles3 ?= "mesa-mainline"
PREFERRED_PROVIDER_virtual/mesa ?= "mesa-mainline"
# Mesa 22.0.y compatibility with dunfell release
PREFERRED_PROVIDER_drm ?= "libdrm-mainline"
PREFERRED_PROVIDER_libdrm ?= "libdrm-mainline"
PREFERRED_PROVIDER_nativesdk-libdrm ?= "nativesdk-libdrm-mainline"
PREFERRED_PROVIDER_wayland-protocols ?= "wayland-protocols-mainline"
PREFERRED_PROVIDER_nativesdk-wayland-protocols ?= "nativesdk-wayland-protocols-mainline"

KERNEL_MODULES_AUTOLOAD += " etnaviv "

PREFERRED_PROVIDER_virtual/kernel ?= "linux-stable"

MACHINE_ESSENTIAL_EXTRA_RDEPENDS += " \
	imx-firmware-sdma-imx7d \
	"
```

## conf/machine/include/dh-imx6-common.inc
```bitbake
ARM_INSTRUCTION_SET = "thumb"

require conf/machine/include/soc-family.inc

SERIAL_CONSOLES = "115200;ttymxc0"

# Linux kernel
PREFERRED_VERSION_linux-stable ?= "6.6%"
KERNEL_DEVICETREE_PATH_PREFIX = "${@'nxp/imx/' if (d.getVar('PREFERRED_VERSION_linux-stable') in ["6.6%"]) else ''}"
KERNEL_DTBVENDORED = "0"
KERNEL_DTC_FLAGS += "-@"

# U-Boot bootloader
UBOOT_MAKE_TARGET := "u-boot-with-spl.imx"
UBOOT_BINARY := "u-boot-with-spl.imx"
UBOOT_SUFFIX ?= "imx"

# Ship firmware
MACHINE_ESSENTIAL_EXTRA_RDEPENDS += " \
	imx-firmware-sdma-imx6q \
	"

WKS_FILE ?= "sdimage-imx6.wks"

# Add any optional config files that might be present e.g. in other layers
include conf/machine/include/dh-imx6-common-extra.inc
include conf/machine/${MACHINE}-extra.conf
```

## conf/machine/include/dh-imx6qdl-common.inc
```bitbake
MACHINEOVERRIDES =. "dh-imx6-dhsom:"

require conf/machine/include/dh-imx-mainline.inc
require conf/machine/include/dh-imx-common.inc

DEFAULTTUNE ?= "cortexa9thf-neon"
SOC_FAMILY ?= "imx6"

# U-Boot bootloader
UBOOT_ENTRYPOINT := "0x17800000"
UBOOT_DTB_LOADADDRESS = "0x1ff00000"
UBOOT_DTBO_LOADADDRESS = "0x1ff80000"

# Ship firmware
MACHINE_ESSENTIAL_EXTRA_RDEPENDS += " \
	imx-firmware-vpu-imx6d \
	imx-firmware-vpu-imx6q \
	"

require conf/machine/include/arm/armv7a/tune-cortexa9.inc
require conf/machine/include/dh-imx6-common.inc
```

## conf/machine/include/dh-imx8mp-common.inc
```bitbake
MACHINEOVERRIDES =. "dh-imx8m-dhsom:dh-imx8mp-dhsom:"

# Include downstream BSP extras only if enabled by setting
# IMX_DEFAULT_BSP = "nxp" in local.conf
include conf/machine/include/dh-imx${@'8mp-downstream' if (d.getVar('IMX_DEFAULT_BSP') in ["nxp"]) else '-mainline'}.inc
require conf/machine/include/dh-imx-common.inc

DEFAULTTUNE ?= "cortexa53-crypto"
SOC_FAMILY ?= "imx8mp"

require conf/machine/include/${@'' if (d.getVar('LAYERSERIES_CORENAMES') in ["dunfell"]) else 'arm/armv8a/'}tune-cortexa53.inc
require conf/machine/include/soc-family.inc

SERIAL_CONSOLE = "115200 ttymxc0"

# Linux kernel
PREFERRED_VERSION_linux-stable ?= "6.6%"
KERNEL_DTBVENDORED = "1"
KERNEL_DTC_FLAGS += "-@"

# U-Boot bootloader
UBOOT_ENTRYPOINT := "0x40200000"
UBOOT_MAKE_TARGET := "flash.bin"
UBOOT_BINARY := "flash.bin"
UBOOT_SUFFIX ?= "bin"
UBOOT_DTB_LOADADDRESS = "0x5c000000"
UBOOT_DTBO_LOADADDRESS = "0x5c080000"

WKS_FILE = "sdimage-imx8mp.wks"

# Add any optional config files that might be present e.g. in other layers
include conf/machine/include/dh-imx8mp-common-extra.inc
include conf/machine/${MACHINE}-extra.conf
```

## conf/machine/include/dh-imx8mp-downstream.inc
```bitbake
# Downstream BSP overrides

MACHINEOVERRIDES =. "mx8mp:"

require conf/machine/include/imx-base.inc

IMX_DEFAULT_BOOTLOADER = "u-boot-mainline"
PREFERRED_PROVIDER_virtual/kernel = "linux-imx"
PREFERRED_PROVIDER_virtual/bootloader = "u-boot-mainline"
# This line below makes use of the OVERRIDE expansion priority
# to override final assignment of virtual/bootloader in broken
# meta-imx distro definitions, those assignments should have
# been weak. The ${MACHINE} is one of the last keys in OVERRIDES
# and thus has highest priority just short of "forcevariable".
PREFERRED_PROVIDER_virtual/bootloader:${MACHINE} = "u-boot-mainline"
KERNEL_IMAGETYPE:${MACHINE} = "fitImage"
IMX_DEFAULT_BOOTLOADER:${MACHINE} = "u-boot-mainline"
IMX_DEFAULT_UBOOTTOOLS:${MACHINE} = "u-boot-mainline-tools"
UBOOT_SUFFIX:${MACHINE} = "bin"

SPL_BINARY = "spl/u-boot-spl.bin"

ATF_PLATFORM = "imx8mp"
IMAGE_BOOTLOADER = "imx-boot"
IMXBOOT_TARGETS = "flash_evk"
IMX_BOOT_SOC_TARGET = "iMX8MP"

DDR_FIRMWARE_VERSION = "202006"
DDR_FIRMWARE_NAME = " \
	lpddr4_pmu_train_1d_dmem_${DDR_FIRMWARE_VERSION}.bin \
	lpddr4_pmu_train_1d_imem_${DDR_FIRMWARE_VERSION}.bin \
	lpddr4_pmu_train_2d_dmem_${DDR_FIRMWARE_VERSION}.bin \
	lpddr4_pmu_train_2d_imem_${DDR_FIRMWARE_VERSION}.bin \
"
```

## files/wic/sdimage-imx6.wks
```
# short-description: Create DH IMX6 SD card image with a boot partition
# long-description: Creates a partitioned SD card image. Boot files
# are located in the first ext4 partition.

part --source rawcopy --sourceparams="file=u-boot-with-spl.imx" --ondisk mmcblk --no-table --align 1 --size 2M
part / --source rootfs --ondisk mmcblk0 --fstype=ext4 --label root --active --align 4096
```

## kas/Kconfig
```kconfig
choice
  prompt "Machine selection"
  help
    OE MACHINE to use during the build.

config MACHINE_IMX6_DHCOM_PDK2
  bool "DH i.MX6 DHCOM PDK2"
  help
    OE MACHINE variable is set to dh-imx6-dhcom-pdk2 .

endchoice

config INCLUDE_EXTRAS_YML
  bool "Build full example dh-image-demo using meta-dhsom-extras layer"
  help
    Include meta-dhsom-extras layer and build full large dh-image-demo
    example image with dhlinux distro, instead of core-image-base with
    nodistro distro, which is the default.

    Note that dh-image-demo is an example image containing a lot of
    features and applications, it is large and requires much longer
    build time.

comment "Inferred and expert settings"

config KAS_BUILD_SYSTEM
  string "KAS build system"
  default "openembedded"
  help
    The build_system that will used. The static kconfig string variable
    KAS_BUILD_SYSTEM defines this value which must be openembedded, oe
    or isar is set.

config KAS_INCLUDE_BSP_YML_FILE
  string "KAS OE MACHINE and BSP layer YML file"
  depends on MACHINE_IMX6_DHCOM_PDK2
  default "dh-imx6-dhcom-pdk2.yml" if MACHINE_IMX6_DHCOM_PDK2

config KAS_INCLUDE_EXTRAS_YML_FILE
  string "KAS Extras layer YML file"
  depends on INCLUDE_EXTRAS_YML
  default "include/common-meta-dhsom-extras.yml"
```
